/**
 * @cliArgs --board "/ti/boards/MSP_EXP432P401R" --product "simplelink_msp432p4_sdk@3.40.01.02"
 * @versions {"data":"2021040816","timestamp":"2021040816","tool":"1.8.1+1900","templates":null}
 */

/**
 * Import the modules used in this configuration.
 */
const Display  = scripting.addModule("/ti/display/Display");
const Display1 = Display.addInstance();
const GPIO     = scripting.addModule("/ti/drivers/GPIO");
const GPIO1    = GPIO.addInstance();
const Power    = scripting.addModule("/ti/drivers/Power");
const RTOS     = scripting.addModule("/ti/drivers/RTOS");
const SD       = scripting.addModule("/ti/drivers/SD");
const SD1      = SD.addInstance();
const SPI      = scripting.addModule("/ti/drivers/SPI", {}, false);
const SPI1     = SPI.addInstance();

/**
 * Write custom configuration values to the imported modules.
 */
Display1.$name      = "CONFIG_Display_0";
Display1.$hardware  = system.deviceData.board.components.XDS110UART;
Display1.uart.$name = "CONFIG_UART_0";

GPIO1.$hardware = system.deviceData.board.components.LED1_RED;
GPIO1.$name     = "CONFIG_GPIO_LED_0";

Power.customPerformanceLevels = 1;
Power.initialPerformanceLevel = 3;
Power.performanceLevel3.$name = "ti_drivers_power_PowerMSP432PerfLevels0";
Power.performanceLevel2.$name = "ti_drivers_power_PowerMSP432PerfLevels1";
Power.performanceLevel1.$name = "ti_drivers_power_PowerMSP432PerfLevels2";
Power.performanceLevel0.$name = "ti_drivers_power_PowerMSP432PerfLevels3";
Power.performanceLevel4.$name = "ti_drivers_power_PowerMSP432PerfLevels4";

RTOS.name = "NoRTOS";

SD1.useFatFS                    = true;
SD1.$name                       = "CONFIG_SDFatFS_0";
SD1.slaveSelect.$name           = "CONFIG_GPIO";
SD1.slaveSelect.gpioPin.$assign = "boosterpack.18";

SPI1.$name               = "CONFIG_SPI_0";
SD1.spiInstance          = SPI1;
SPI1.spi.$assign         = "EUSCI_B0";
SPI1.spi.sclkPin.$assign = "boosterpack.7";
SPI1.spi.misoPin.$assign = "boosterpack.14";
SPI1.spi.mosiPin.$assign = "boosterpack.15";

/**
 * These are the reserved peripherals and settings in this configuration
 */
const iGPIO1         = scripting.addPeripheral("GPIO");
iGPIO1.$numPins      = 16;
iGPIO1["0"].$assign  = "boosterpack.13";
iGPIO1["1"].$assign  = "boosterpack.33";
iGPIO1["2"].$assign  = "boosterpack.12";
iGPIO1["3"].$assign  = "expansion.10";
iGPIO1["4"].$assign  = "boosterpack.29";
iGPIO1["5"].$assign  = "boosterpack.30";
iGPIO1["6"].$assign  = "boosterpack.37";
iGPIO1["7"].$assign  = "boosterpack.17";
iGPIO1["8"].$assign  = "boosterpack.2";
iGPIO1["9"].$assign  = "boosterpack.23";
iGPIO1["10"].$assign = "expansion.11";
iGPIO1["11"].$assign = "expansion.14";
iGPIO1["12"].$assign = "boosterpack.10";
iGPIO1["13"].$assign = "boosterpack.9";
iGPIO1["14"].$assign = "boosterpack.36";
iGPIO1["15"].$assign = "boosterpack.35";
iGPIO1.$name         = "DATA";

/**
 * Pinmux solution for unlocked pins/peripherals. This ensures that minor changes to the automatic solver in a future
 * version of the tool will not impact the pinmux you originally saw.  These lines can be completely deleted in order to
 * re-solve from scratch.
 */
Display1.uart.uart.$suggestSolution          = "EUSCI_A0";
Display1.uart.uart.txPin.$suggestSolution    = "7";
Display1.uart.uart.rxPin.$suggestSolution    = "6";
GPIO1.gpioPin.$suggestSolution               = "4";
RTOS.timer0.resource.$suggestSolution        = "Timer_A0";
SPI1.spi.dmaRxChannel.$suggestSolution       = "DMA_CH1";
SPI1.spi.dmaTxChannel.$suggestSolution       = "DMA_CH0";
SPI1.spi.dmaInterruptNumber.$suggestSolution = "DMA_INT0";
